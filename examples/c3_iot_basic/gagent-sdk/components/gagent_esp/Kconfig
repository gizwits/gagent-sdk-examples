## examples/c3_iot_basic/gagent-sdk/components/gagent_esp/Kconfig
```kconfig
menu "GAgent memory placement"

config GAGENT_SMALL_ALLOC_RTC
    bool "Prefer RTC RAM for small CPU-only allocations"
    default y
    help
        Prefer an available RTC heap for allocations up to 256 bytes whose requested
        capabilities are limited to DEFAULT, INTERNAL, 8BIT and 32BIT. This
        keeps small metadata from splitting large radio/TLS buffers in SRAM.
        All requested capabilities remain required. DMA, executable and other
        special allocations keep the SDK policy. If no compatible RTC heap
        exists on the target, or RTC RAM is full, retry
        with the original capabilities using the SDK's preference allocator.

endmenu

menu "GAgent runtime logs"
config GAGENT_RUNTIME_LOG_UPLOAD_URL
    string "Runtime log HTTP upload URL"
    default "http://sdkdevops.gizwitsapi.com/device/logs/batches"
    help
        Only used after an explicit MQTT enable command. No UDP or Flash queue.
config GAGENT_RUNTIME_LOG_UPLOAD_TOKEN
    string "Product runtime log upload token"
    default "abcbc5ad5a726bc329a70bf5c8db1e82a7739406c46a62973bbbfe2d787051e2"
    help
        16..128 characters. Match DEVICE_LOG_UPLOAD_KEYS for the active cloud PK.
        An empty token prevents capture. Never use a product/device secret here.
endmenu
```

## examples/p4_iot_basic/gagent-sdk/components/gagent_core/Kconfig
```kconfig
menu "GAgent diagnostics"

config GAGENT_TRANSPORT_DIAGNOSTICS
    bool "Sample Worker and BLE transport performance"
    default n
    help
        Collect timing and traffic counters and print periodic INFO summaries.
        Disabled builds omit the sampling and counter storage entirely.

config GAGENT_CONTROL_LOG_DEBUG
    bool "Log successful control requests at DEBUG instead of INFO"
    default n
    help
        Reduce per-request logs for high-rate board protocols. Errors retain
        their original severity. Other boards keep normal control logs at INFO.

config GAGENT_MCU_DEBUG
    bool "Print MCU UART RX/TX bytes at INFO"
    default n
    help
        Print raw UART bytes in bounded hex/ASCII rows. RX is MCU to module;
        TX is module to MCU. Includes handshake, reports, commands, ACKs,
        heartbeats, OTA and board-specific serial exchanges. RX chunks may
        contain partial frames or multiple frames, including invalid data.
        Includes credentials carried on the wire. Requires INFO logging.

endmenu
```

## examples/p4_iot_basic/sdkconfig.defaults
```kconfig
# 客户工程配置：在 SDK 默认配置之后应用。
# Flash 容量和分区由工程维护，其余设置需满足 SDK 的二进制兼容要求。
CONFIG_PARTITION_TABLE_CUSTOM_FILENAME="partitions.csv"
```
